## arch/arm/mach-msm/Kconfig.rej
```kconfig
--- arch/arm/mach-msm/Kconfig	2013-06-24 02:50:48.000000000 -0600
+++ arch/arm/mach-msm/Kconfig	2013-08-01 23:38:05.000000000 -0600
@@ -146,6 +146,7 @@
 	select MSM_RUN_QUEUE_STATS
 	select ARM_HAS_SG_CHAIN
 	select MSM_KRAIT_WFE_FIXUP
+	select MSM_IOMMU_GPU_SYNC
 
 config ARCH_MSM8930
 	bool "MSM8930"
@@ -458,6 +459,10 @@
         default n
         bool "HTC Performance Lock"
 
+config DEBUG_KSWAPD
+        default n
+        bool "HTC Debug Kswapd busy"
+
 config PERFLOCK_FIX_UP
         depends on CPU_FREQ
         depends on PERFLOCK
@@ -2676,23 +2681,23 @@
 	help
 	  Support for the HTC APQ8064 MONARUDO.
 
-config MACH_M7_UL
+config MACH_DELUXE_J
         depends on ARCH_APQ8064
-        bool "APQ8064 M7_UL"
+        bool "APQ8064 DELUXE_J"
         help
-          Support for the HTC APQ8064 M7_UL.
+          Support for the HTC APQ8064 DELUXE_J.
 
-config MACH_M7_DXG
+config MACH_IMPRESSION_J
         depends on ARCH_APQ8064
-        bool "APQ8064 M7_DXG"
+        bool "APQ8064 IMPRESSION_J"
         help
-          Support for the HTC APQ8064 M7_DXG.
+          Support for the HTC APQ8064 IMPRESSION_J.
 
-config MACH_T6_DXG
+config MACH_M7_UL
         depends on ARCH_APQ8064
-        bool "APQ8064 T6_DXG"
+        bool "APQ8064 M7_UL"
         help
-          Support for the HTC APQ8064 T6_DXG.
+          Support for the HTC APQ8064 M7_UL.
 
 config QSC_MODEM
         default n
@@ -2755,5 +2760,10 @@
 	  stand alone power collapse operation. Selecting this option
 	  ensures that they are always off.
 
+config QUALCOMM_WLAN_PXO
+	default n
+	bool "Use PXO for WLAN clock source"
+	help
+	  Use PXO for clock source of WLAN chip
 endif
 
```

## drivers/gpu/msm/Kconfig.rej
```kconfig
--- drivers/gpu/msm/Kconfig	2013-06-24 02:50:48.000000000 -0600
+++ drivers/gpu/msm/Kconfig	2013-08-01 23:38:05.000000000 -0600
@@ -97,17 +97,6 @@
 	default n
 	depends on MSM_KGSL
 
-config MSM_KGSL_DEFAULT_GPUMMU
-	bool "Prefer gpummu than iommu"
-	default n
-
-config MSM_KGSL_PAGE_TABLE_SIZE_FOR_IOMMU
-	hex "Size of pagetables for iommu"
-	default 0x1FE00000
-	---help---
-	Sets the pagetable size used by the IOMMU.  The max value
-	is 0x1FE00000 or (512M - 1536K - little interval).
-
 config MSM_KGSL_KILL_HANG_PROCESS
 	bool "Enable killing recoverable gpu hang process routine"
 	default y
```

## drivers/video/msm/Kconfig.rej
```kconfig
--- drivers/video/msm/Kconfig	2013-06-24 02:50:48.000000000 -0600
+++ drivers/video/msm/Kconfig	2013-08-01 23:38:05.000000000 -0600
@@ -1041,8 +1041,7 @@
 
 config FB_MSM_UNDERFLOW_WORKAROUND
 	bool "Display underflow workaround"
-	default y if !TRACING
-	default n
+	default y
 	---help---
 	  Force underflow color to black to avoid blue splash.
 	  Say Y here after CRC stage.
```
